## os/Config.in
```kconfig
menu "SoundTap"

source "$BR2_EXTERNAL_SOUNDTAP_PATH/package/Config.in"

endmenu
```

## os/package/Config.in
```kconfig
source "$BR2_EXTERNAL_SOUNDTAP_PATH/package/soundtapd/Config.in"
source "$BR2_EXTERNAL_SOUNDTAP_PATH/package/soundtap-aic3256-loader/Config.in"
source "$BR2_EXTERNAL_SOUNDTAP_PATH/package/soundtap-runtime/Config.in"
source "$BR2_EXTERNAL_SOUNDTAP_PATH/package/soundtap-librespot/Config.in"
source "$BR2_EXTERNAL_SOUNDTAP_PATH/package/soundtap-ffmpeg/Config.in"
source "$BR2_EXTERNAL_SOUNDTAP_PATH/package/soundtap-snapcast/Config.in"
source "$BR2_EXTERNAL_SOUNDTAP_PATH/package/soundtap-nqptp/Config.in"
source "$BR2_EXTERNAL_SOUNDTAP_PATH/package/soundtap-shairport-sync/Config.in"
source "$BR2_EXTERNAL_SOUNDTAP_PATH/package/soundtap-wl18xx-conf/Config.in"
source "$BR2_EXTERNAL_SOUNDTAP_PATH/package/soundtap-bootloaders/Config.in"
source "$BR2_EXTERNAL_SOUNDTAP_PATH/package/soundtap-bco-app/Config.in"
```

## os/package/soundtap-aic3256-loader/Config.in
```kconfig
config BR2_PACKAGE_SOUNDTAP_AIC3256_LOADER
	bool "SoundTap AIC3256 loader"
	help
	  Build the bounded userspace SPI codec loader used by the ST10
	  mainline Linux profile.

config BR2_PACKAGE_SOUNDTAP_AIC3256_LOADER_BITBANG
	bool "aic3256-bitbang"
	depends on BR2_PACKAGE_SOUNDTAP_AIC3256_LOADER
	help
	  Also build the GPIO bit-banged codec loader. The ST20 has
	  spi0 off and reaches its AIC3256 only through this.
```

## os/package/soundtap-bco-app/Config.in
```kconfig
config BR2_PACKAGE_HOST_SOUNDTAP_BCO_APP
	bool "host SoundTap BCO app"
	depends on BR2_HOSTARCH = "aarch64" || BR2_HOSTARCH = "x86_64"
	help
	  Our own ARM926 application for the SoundTouch 20's BridgeCo
	  DM870 (bco/app), built bare-metal with a pinned
	  arm-none-eabi toolchain. Installs app.bin, app.elf and a
	  bCoD without any Bose bytes per variant.
```

## os/package/soundtap-bootloaders/Config.in
```kconfig
config BR2_PACKAGE_HOST_SOUNDTAP_BOOTLOADERS
	bool "host SoundTap bootloaders"
	depends on BR2_HOSTARCH = "aarch64" || BR2_HOSTARCH = "x86_64"
	help
	  The mainline SPL and U-Boot images the STUs carry, built
	  from os/bootloader's source, patches and final .config
	  with the same Debian gcc 12 cross compiler.

if BR2_PACKAGE_HOST_SOUNDTAP_BOOTLOADERS

config BR2_PACKAGE_HOST_SOUNDTAP_BOOTLOADERS_ST20
	bool "ST20 SPL"
	help
	  st20-spl: MLO, u-boot-spl.bin, uImage-spl-sram. The
	  shared SPL with USB first, as the ST20 ROM boots NAND
	  before USB. U-Boot is wla-uboot, as on the other models.

config BR2_PACKAGE_HOST_SOUNDTAP_BOOTLOADERS_WLA
	bool "WLA product SPL and U-Boot"
	help
	  wla-spl: the product NAND MLO.
	  wla-uboot: the NAND-booting u-boot.img with its
	  environment in NAND.

endif
```

## os/package/soundtap-ffmpeg/Config.in
```kconfig
config BR2_PACKAGE_SOUNDTAP_FFMPEG
	bool "soundtap-ffmpeg"
	depends on BR2_PACKAGE_FFMPEG_ARCH_SUPPORTS
	depends on BR2_TOOLCHAIN_HAS_THREADS
	select BR2_PACKAGE_LIBSOXR
	select BR2_PACKAGE_OPENSSL
	select BR2_PACKAGE_ZLIB
	help
	  Audio-only FFmpeg 9 for the radio player and shairport-sync.
	  The pinned Buildroot ships 6.1, whose CVEs are fixed only from
	  9.0, and its recipe does not build 9.

	  https://www.ffmpeg.org
```

## os/package/soundtap-librespot/Config.in
```kconfig
config BR2_PACKAGE_SOUNDTAP_LIBRESPOT
	bool "soundtap-librespot"
	depends on BR2_PACKAGE_HOST_RUSTC_TARGET_ARCH_SUPPORTS
	select BR2_PACKAGE_ALSA_LIB
	select BR2_PACKAGE_AVAHI
	select BR2_PACKAGE_DBUS
	select BR2_PACKAGE_HOST_RUSTC
	help
	  Spotify Connect client built with the ALSA output and Avahi
	  discovery backends. SoundTap patches software attenuation out
	  so the daemon remains the single master-gain owner.

	  https://github.com/librespot-org/librespot

comment "soundtap-librespot needs a Rust-capable target architecture"
	depends on !BR2_PACKAGE_HOST_RUSTC_TARGET_ARCH_SUPPORTS
```

## os/package/soundtap-nqptp/Config.in
```kconfig
config BR2_PACKAGE_SOUNDTAP_NQPTP
	bool "soundtap-nqptp"
	depends on BR2_USE_MMU
	depends on BR2_TOOLCHAIN_HAS_THREADS
	help
	  nqptp 1.2.9, the PTP timing companion Shairport Sync needs for
	  AirPlay 2, pinned for SoundTap.

	  https://github.com/mikebrady/nqptp
```

## os/package/soundtap-runtime/Config.in
```kconfig
config BR2_PACKAGE_SOUNDTAP_RUNTIME
	bool "SoundTap runtime"
	depends on BR2_INSTALL_LIBSTDCPP
	depends on BR2_PACKAGE_FFMPEG_ARCH_SUPPORTS
	depends on BR2_PACKAGE_HOST_RUSTC_TARGET_ARCH_SUPPORTS
	depends on BR2_PACKAGE_LIBGPG_ERROR_ARCH_SUPPORTS
	depends on BR2_TOOLCHAIN_GCC_AT_LEAST_4_9
	depends on BR2_TOOLCHAIN_HAS_SYNC_4
	depends on BR2_TOOLCHAIN_HAS_THREADS_NPTL
	depends on BR2_TOOLCHAIN_HEADERS_AT_LEAST_3_4
	depends on BR2_USE_MMU
	depends on BR2_USE_WCHAR
	depends on !BR2_STATIC_LIBS
	select BR2_PACKAGE_ALSA_UTILS
	select BR2_PACKAGE_ALSA_UTILS_APLAY
	select BR2_PACKAGE_AVAHI
	select BR2_PACKAGE_AVAHI_DAEMON
	select BR2_PACKAGE_BLUEZ5_UTILS
	select BR2_PACKAGE_BLUEZ5_UTILS_CLIENT
	select BR2_PACKAGE_BLUEZ5_UTILS_PLUGINS_AUDIO
	select BR2_PACKAGE_BLUEZ_ALSA
	select BR2_PACKAGE_CA_CERTIFICATES
	select BR2_PACKAGE_DBUS
	select BR2_PACKAGE_HOSTAPD
	select BR2_PACKAGE_HOSTAPD_DRIVER_NL80211
	select BR2_PACKAGE_IW
	select BR2_PACKAGE_OPENSSL
	select BR2_PACKAGE_SOUNDTAP_FFMPEG
	select BR2_PACKAGE_SOUNDTAP_LIBRESPOT
	select BR2_PACKAGE_SOUNDTAP_SHAIRPORT_SYNC
	select BR2_PACKAGE_SOUNDTAP_SNAPCAST
	select BR2_PACKAGE_SOUNDTAPD
	select BR2_PACKAGE_WPA_SUPPLICANT
	select BR2_PACKAGE_WPA_SUPPLICANT_CLI
	select BR2_PACKAGE_WPA_SUPPLICANT_CTRL_IFACE
	select BR2_PACKAGE_WPA_SUPPLICANT_NL80211
	select BR2_PACKAGE_WPA_SUPPLICANT_PASSPHRASE
	help
	  Runtime scripts and network/audio receiver configuration for
	  supported SoundTap products.

comment "SoundTap runtime needs C++, NPTL, wchar, dynamic libraries, Rust and FFmpeg support"
	depends on !BR2_INSTALL_LIBSTDCPP || !BR2_TOOLCHAIN_HAS_THREADS_NPTL || \
		!BR2_USE_WCHAR || BR2_STATIC_LIBS || \
		!BR2_PACKAGE_HOST_RUSTC_TARGET_ARCH_SUPPORTS || \
		!BR2_PACKAGE_FFMPEG_ARCH_SUPPORTS
```

## os/package/soundtap-shairport-sync/Config.in
```kconfig
config BR2_PACKAGE_SOUNDTAP_SHAIRPORT_SYNC
	bool "soundtap-shairport-sync"
	depends on BR2_INSTALL_LIBSTDCPP
	depends on BR2_PACKAGE_FFMPEG_ARCH_SUPPORTS
	depends on BR2_PACKAGE_LIBGPG_ERROR_ARCH_SUPPORTS
	depends on BR2_TOOLCHAIN_HAS_THREADS_NPTL
	depends on BR2_USE_MMU
	select BR2_PACKAGE_ALSA_LIB
	select BR2_PACKAGE_ALSA_LIB_MIXER
	select BR2_PACKAGE_AVAHI
	select BR2_PACKAGE_AVAHI_DAEMON
	select BR2_PACKAGE_DBUS
	select BR2_PACKAGE_SOUNDTAP_FFMPEG
	select BR2_PACKAGE_LIBCONFIG
	select BR2_PACKAGE_LIBGCRYPT
	select BR2_PACKAGE_LIBPLIST
	select BR2_PACKAGE_LIBSODIUM
	select BR2_PACKAGE_LIBSOXR
	select BR2_PACKAGE_SOUNDTAP_NQPTP
	select BR2_PACKAGE_OPENSSL
	select BR2_PACKAGE_POPT
	select BR2_PACKAGE_UTIL_LINUX
	select BR2_PACKAGE_UTIL_LINUX_LIBUUID
	help
	  Shairport Sync 5.6 AirPlay 2 receiver pinned for SoundTap.

	  https://github.com/mikebrady/shairport-sync

comment "soundtap-shairport-sync needs a toolchain w/ C++, NPTL and FFmpeg support"
	depends on !BR2_INSTALL_LIBSTDCPP || !BR2_TOOLCHAIN_HAS_THREADS_NPTL || \
		!BR2_PACKAGE_FFMPEG_ARCH_SUPPORTS
```

## os/package/soundtap-snapcast/Config.in
```kconfig
config BR2_PACKAGE_SOUNDTAP_SNAPCAST
	bool "soundtap-snapcast"
	depends on BR2_INSTALL_LIBSTDCPP
	depends on BR2_TOOLCHAIN_HAS_THREADS
	depends on BR2_USE_MMU
	depends on BR2_USE_WCHAR
	depends on !BR2_STATIC_LIBS
	select BR2_PACKAGE_ALSA_LIB
	select BR2_PACKAGE_AVAHI
	select BR2_PACKAGE_AVAHI_DAEMON
	select BR2_PACKAGE_BOOST
	select BR2_PACKAGE_DBUS
	select BR2_PACKAGE_EXPAT
	select BR2_PACKAGE_FLAC
	select BR2_PACKAGE_LIBSOXR
	select BR2_PACKAGE_OPENSSL
	help
	  Snapcast 0.35 client and server for SoundTap synchronized
	  multiroom playback; the group stream is FLAC.

	  https://github.com/badaix/snapcast

comment "soundtap-snapcast needs a toolchain w/ C++, threads, wchar, dynamic library"
	depends on !BR2_INSTALL_LIBSTDCPP || !BR2_TOOLCHAIN_HAS_THREADS || \
		!BR2_USE_WCHAR || BR2_STATIC_LIBS
```

## os/package/soundtap-wl18xx-conf/Config.in
```kconfig
config BR2_PACKAGE_SOUNDTAP_WL18XX_CONF
	bool "SoundTap WiLink8 board configuration"
	help
	  The per-region wl18xx-conf.bin for the WL1835MOD on every
	  model, generated at build time by TI's wlconf (18xx-ti-utils
	  R8.8, built for the host only) from the documented text in
	  this package.
```
